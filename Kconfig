## drivers/temp-sensor/Kconfig
```kconfig
config TSYS01_SENSOR
    bool "TSYS01 temperature sensor"
    default n
    depends on I2C
    depends on HN_SPI2C
    help
      Enables the TSYS01 temperature sensor driver using Zephyr I2C API.
```

## dts/bindings/input/hn,i2c-bus.yaml
```yaml
description: I2C bus driver

compatible: "hn,i2c-bus"

include: base.yaml

properties: 
  i2c-controller:
    type: phandle
    required: true
    description: the physical i2c connection
```

## dts/bindings/input/tsys01,sensor.yaml
```yaml
description: Temp Sensor

compatible: "tsys01,sensor"

include: base.yaml

properties: {}
```

## i2c-bus-driver/i2c-bus/Kconfig
```kconfig
config I2C_BUS
    bool "i2c bus for the spi2c driver"
    default n
    depends on I2C
    depends on HN_SPI2C
    help
      Enables the i2c bus register
```
